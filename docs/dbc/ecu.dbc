VERSION ""

NS_ :

BS_:

BU_: AMS VCU ECU UDV Pit_Tool

BO_ 256 VCU_heartbeat: 2 VCU
 SG_ dc_bus_voltage : 0|16@1+ (1,0) [0|0] "V" Vector__XXX
